## boards/shields/no-arrows/Kconfig.defconfig
```kconfig
# Copyright (c) 2024 J. Westley
# SPDX-License-Identifier: MIT

if NO_ARROWS

config ZMK_KEYBOARD_NAME
    default "Arrows are for Chumps"

endif
```

## boards/shields/no_arrows/Kconfig.defconfig
```kconfig
# Copyright (c) 2024 J. Westley
# SPDX-License-Identifier: MIT

if SHIELD_NO_ARROWS

config ZMK_KEYBOARD_NAME
    default "Arrows are for Chumps!"
config USB_DEVICE_MANUFACTURER
    default "ZMK Project"
config ZMK_RGB_UNDERGLOW_EFF_START
    int "RGB underglow start effect int value related to the effect enum list"
    range 0 3
    default 2

endif
```

## boards/shields/no_arrows/Kconfig.shield
```kconfig
# Copyright (c) 2024 J. Westley
# SPDX-License-Identifier: MIT

config SHIELD_NO_ARROWS
    def_bool $(shields_list_contains,no_arrows)
```

## config/west.yml
```yaml
manifest:
  remotes:
    - name: zmkfirmware
      url-base: https://github.com/zmkfirmware
    # Additional modules containing boards/shields/custom code can be listed here as well
    # See https://docs.zephyrproject.org/3.2.0/develop/west/manifest.html#projects
    - name: zmk-no-arrows
      url-base: https://github.com/Frank-08
  projects:
    - name: zmk
      remote: zmkfirmware
      revision: main
      import: app/west.yml
    - name: zmk-no-arrows
      remote: zmk-no-arrows
      revision: main

  self:
    path: config
```
